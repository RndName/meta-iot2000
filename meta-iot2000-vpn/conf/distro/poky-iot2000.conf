## meta-iot2000-vpn/conf/distro/poky-iot2000.conf
```bitbake
require conf/distro/poky.conf

DISTRO = "poky-iot2000"
DISTRO_NAME = "IOT2000 VPN Image"
DISTRO_VERSION = "V3.1.1"

BINDINGS_pn-mraa = "python"

WICVARS += "BBLAYERS \
            HDDDIR \
            RECIPE_SYSROOT_NATIVE \
            IMAGE_ROOTFS DEPLOY_DIR_IMAGE \
            FAKEROOTCMD \
            FAKEROOTDIRS \
            FAKEROOTENV \
            FAKEROOTNOENV \
            PSEUDO_PREFIX \
            PSEUDO_LOCALSTATEDIR \
            PSEUDO_PASSWD \
            PSEUDO_NOSYMLINKEXP \
            "
```
